## config/boards/shields/lagom65/Kconfig.defconfig
```kconfig
if SHIELD_LAGOM65

config ZMK_KEYBOARD_NAME
    default "lagom65"

endif # SHIELD_LAGOM65
```

## config/west.yml
```yaml
manifest:
  remotes:
    - name: zmkfirmware
      url-base: https://github.com/zmkfirmware
    - name: jetjetjet
      url-base: https://github.com/jetjetjet
  projects:
    - name: zmk
      remote: zmkfirmware
      revision: main
      import: app/west.yml
    - name: zmk-keyboards-lagom
      remote: lagom65
      revision: main
  self:
    path: config
```
